## boards/arm/aa_19904_kardup_temp_sensor/aa_kardup_temp_sensor_nrf52832_defconfig
```kconfig
CONFIG_SOC_SERIES_NRF52X=y
CONFIG_SOC_NRF52832_QFAA=y
CONFIG_BOARD_AA_KARDUP_TEMP_SENSOR_NRF52832=y

# Enable MPU
CONFIG_ARM_MPU=y

# Enable hardware stack protection
CONFIG_HW_STACK_PROTECTION=y

# Enable RTT
CONFIG_USE_SEGGER_RTT=y

# enable GPIO
CONFIG_GPIO=y

# enable uart driver
CONFIG_SERIAL=y

# enable console
CONFIG_CONSOLE=y
CONFIG_UART_CONSOLE=y

# additional board options
CONFIG_GPIO_AS_PINRESET=y

# Configure NFC pins as GPIO
CONFIG_NFCT_PINS_AS_GPIOS=y

CONFIG_PINCTRL=y
```

## lib/boards/arm/aa_19904_kardup_temp_sensor/Kconfig.defconfig
```kconfig
# EV-BT832 DK NRF52832 board configuration

# Copyright (c) 2016 Nordic Semiconductor ASA
# SPDX-License-Identifier: Apache-2.0

if BOARD_AA_KARDUP_TEMP_SENSOR_NRF52832

config BOARD
	default "aa_kardup_temp_sensor_nrf52832"

config BT_CTLR
	default BT

endif # BOARD_AA_KARDUP_TEMP_SENSOR_NRF52832
```

## lib/boards/arm/fansteldk_nrf52832/Kconfig.board
```kconfig
# nRF52 DK NRF52832 board configuration

# Copyright (c) 2016 Nordic Semiconductor ASA
# SPDX-License-Identifier: Apache-2.0

config BOARD_FANSTELDK_NRF52832
	bool "Fanstel DK NRF52832"
	depends on SOC_NRF52832_QFAA
```
