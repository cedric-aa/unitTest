## CMakeLists.txt
```
#
# Copyright (c) 2020 Nordic Semiconductor ASA
#
# SPDX-License-Identifier: LicenseRef-Nordic-5-Clause
#
cmake_minimum_required(VERSION 3.20.0)

find_package(Zephyr REQUIRED HINTS $ENV{ZEPHYR_BASE})
project(NONE)

set(LIB_ROOT ${CMAKE_CURRENT_SOURCE_DIR}/../lib)

# NORDIC SDK APP START
target_sources(app PRIVATE
	src/main.c
	src/model_handler.c
	${LIB_ROOT}/mesh_model/src/vnd_unit_control_aa.c
	${LIB_ROOT}/mesh_model/src/vnd_motor_aa.c
	${LIB_ROOT}/mesh_model/src/vnd_motor_client_aa.c
	${LIB_ROOT}/mesh_model/src/vnd_unit_control_client_aa.c
	${LIB_ROOT}/mesh_model/src/storage_aa.c
	${LIB_ROOT}/mesh_model/src/vnd_sensor_aa.c
	${LIB_ROOT}/mesh_model/src/vnd_sensor_client_aa.c
	${LIB_ROOT}/mesh_model/src/vnd_activation_aa.c
	${LIB_ROOT}/common/src/uart_aa.c
	${LIB_ROOT}/common/src/check_crc_aa.c
	${LIB_ROOT}/common/src/message_format_aa.c)


target_include_directories(app PRIVATE include
	${LIB_ROOT}/mesh_model/include
	${LIB_ROOT}/common/include)
# NORDIC SDK APP END
```

## prj.conf
```kconfig
#
# Copyright (c) 2020 Nordic Semiconductor ASA
#
# SPDX-License-Identifier: LicenseRef-Nordic-5-Clause
#
CONFIG_NCS_SAMPLES_DEFAULTS=y



# General configuration
CONFIG_MAIN_STACK_SIZE=4096
CONFIG_SYSTEM_WORKQUEUE_STACK_SIZE=4096
CONFIG_FLASH=y
CONFIG_FLASH_MAP=y
CONFIG_NVS=y
CONFIG_SETTINGS=y
CONFIG_HWINFO=y
CONFIG_DK_LIBRARY=y
CONFIG_PM_SINGLE_IMAGE=y
CONFIG_PM_PARTITION_SIZE_SETTINGS_STORAGE=0x8000

# Bluetooth configuration
CONFIG_BT=y
CONFIG_BT_COMPANY_ID=0x0059
CONFIG_BT_DEVICE_NAME="Mesh_Hub"
CONFIG_BT_L2CAP_TX_MTU=69
CONFIG_BT_L2CAP_TX_BUF_COUNT=32
CONFIG_BT_OBSERVER=y
CONFIG_BT_PERIPHERAL=y
CONFIG_BT_SETTINGS=y
CONFIG_BT_RX_STACK_SIZE=2300

# Disable unused Bluetooth features
CONFIG_BT_CTLR_DUP_FILTER_LEN=0
CONFIG_BT_CTLR_LE_ENC=n
CONFIG_BT_DATA_LEN_UPDATE=n
CONFIG_BT_PHY_UPDATE=n
CONFIG_BT_CTLR_CHAN_SEL_2=n
CONFIG_BT_CTLR_MIN_USED_CHAN=n
CONFIG_BT_CTLR_PRIVACY=n

# Bluetooth mesh configuration
CONFIG_BT_MESH=y
CONFIG_BT_MESH_RELAY=y
CONFIG_BT_MESH_FRIEND=y
CONFIG_BT_MESH_ADV_BUF_COUNT=64
CONFIG_BT_MESH_TX_SEG_MAX=24
CONFIG_BT_MESH_RX_SEG_MAX=16
CONFIG_BT_MESH_PB_GATT=y
CONFIG_BT_MESH_GATT_PROXY=y
CONFIG_BT_MESH_PROXY_USE_DEVICE_NAME=y
CONFIG_BT_MESH_DK_PROV=y

# Bluetooth mesh models
CONFIG_BT_MESH_SENSOR_CLI=y
CONFIG_BT_MESH_LVL_CLI=y
# enable custom model
CONFIG_BT_MESH_MODEL_VND_MSG_CID_FORCE=n
#enable segmentation message
CONFIG_BT_MESH_TX_SEG_MSG_COUNT=2

#uart async api
CONFIG_SERIAL=y
CONFIG_UART_ASYNC_API=y

# Enable Bluetooth mesh models debug logs
CONFIG_LOG_MODE_MINIMAL=y
CONFIG_BT_DEBUG_LOG=n
CONFIG_BT_MESH_DEBUG=n
CONFIG_BT_MESH_DEBUG_MODEL=n
CONFIG_BT_MESH_DEBUG_ACCESS=n
CONFIG_BT_MESH_DEBUG_TRANS=n
CONFIG_LOG=y

# Deffered logging helps improve LPN power consumption
# when friendship is established.
CONFIG_LOG_MODE_DEFERRED=y

#disable uart log enable rtt log to use uart async api  
CONFIG_LOG_PROCESS_THREAD=y
CONFIG_LOG_BACKEND_UART=n
CONFIG_LOG_BACKEND_RTT=y
CONFIG_UART_CONSOLE=n
CONFIG_RTT_CONSOLE=y
CONFIG_USE_SEGGER_RTT=y
```

## src/main.c
```c
/*
 * Copyright (c) 2020 Nordic Semiconductor ASA
 *
 * SPDX-License-Identifier: LicenseRef-Nordic-5-Clause
 */

/** @file
 *  @brief Nordic mesh sensor observer sample
 */
#include <zephyr/bluetooth/bluetooth.h>
#include <bluetooth/mesh/models.h>
#include <bluetooth/mesh/dk_prov.h>
#include <dk_buttons_and_leds.h>
#include "model_handler.h"
#include "uart_aa.h"

static void bt_ready(int err)
{
	if (err) {
		printk("Bluetooth init failed (err %d)\n", err);
		return;
	}

	printk("Bluetooth initialized\n");

	dk_leds_init();
	dk_buttons_init(NULL);

	err = uartInit();
	if (err) {
		printk("Initializing uart failed (err %d)\n", err);
		return;
	}

	err = bt_mesh_init(bt_mesh_dk_prov_init(), model_handler_init());
	if (err) {
		printk("Initializing mesh failed (err %d)\n", err);
		return;
	}

	if (IS_ENABLED(CONFIG_SETTINGS)) {
		settings_load();
	}

	/* This will be a no-op if settings_load() loaded provisioning info */
	bt_mesh_prov_enable(BT_MESH_PROV_ADV | BT_MESH_PROV_GATT);

	printk("Mesh initialized\n");
}

void main(void)
{
	int err;

	printk("Initializing...\n");

	err = bt_enable(bt_ready);
	if (err) {
		printk("Bluetooth init failed (err %d)\n", err);
	}
}
```

## include/model_handler.h
```c
/*
 * Copyright (c) 2020 Nordic Semiconductor ASA
 *
 * SPDX-License-Identifier: LicenseRef-Nordic-5-Clause
 */

/**
 * @file
 * @brief Model handler
 */

#ifndef MODEL_HANDLER_H__
#define MODEL_HANDLER_H__

#include <zephyr/bluetooth/mesh.h>
#include "vnd_activation_aa.h"

#ifdef __cplusplus
extern "C" {
#endif

const struct bt_mesh_comp *model_handler_init(void);

struct SettingsControlState {
	struct btMeshActivation *activation;
};

extern struct SettingsControlState *const ctl;

#ifdef __cplusplus
}
#endif

#endif /* MODEL_HANDLER_H__ */
```

## include/model_level_cli_aa.h
```c
#ifndef MODEL_LEVEL_CLI_AA_H__
#define MODEL_LEVEL_CLI_AA_H__

#include <bluetooth/mesh/gen_lvl_cli.h>

int sendGetLvl(struct bt_mesh_lvl_cli level_cli);
int sendSetLvl(struct bt_mesh_lvl_cli level_cli);
extern void levelMotorStatusHandler(struct bt_mesh_lvl_cli *cli, struct bt_mesh_msg_ctx *ctx,
				    const struct bt_mesh_lvl_status *status);

#endif
```

## include/model_sensor_cli_aa.h
```c
#ifndef MODEL_SENSOR_CLI_AA_H__
#define MODEL_SENSOR_CLI_AA_H__

#include <bluetooth/mesh/sensor_cli.h>
#include <bluetooth/mesh/sensor_types.h>

extern const struct bt_mesh_sensor_cli_handlers sensorCliHandlers;

#endif
```

## src/model_handler.c
```c
#include <zephyr/bluetooth/bluetooth.h>
#include <bluetooth/mesh/models.h>
#include <dk_buttons_and_leds.h>
#include <zephyr/logging/log.h>
#include "model_handler.h"
#include "vnd_unit_control_client_aa.h"
#include "vnd_motor_client_aa.h"
#include "vnd_activation_aa.h"
#include "vnd_sensor_client_aa.h"
#include "uart_aa.h"
#include "message_format_aa.h"

LOG_MODULE_REGISTER(model_handler, LOG_LEVEL_INF);

#define THREAD_PUBLISHER_STACKSIZE 2048
#define THREAD_PUBLISHER_PRIORITY 14

static struct btMeshUnitControl unitControl = {
	.handlers = &unitControlHandlers,
};

struct btMeshMotor motor = {
	.handlers = &motorHandlers,
};

static struct btMeshActivation activation = {
	.handlers = &activationHandlers,
};

static struct btMeshSensor sensor = {
	.handlers = &sensorHandlers,
};

struct SettingsControlState settingsCtlState = {
	.activation = &activation,
};

struct SettingsControlState *const ctl = &settingsCtlState;

void publisherThread(void)
{
	dataQueueItemType publisherQueueItem;
	int err;

	while (1) {
		k_msgq_get(&publisherQueue, &publisherQueueItem, K_FOREVER);

		//LOG_HEXDUMP_INF(publisherQueueItem.bufferItem, publisherQueueItem.length,
		//		"Hub Publisher Thread");

		processedMessage processedMessage = processPublisherQueueItem(&publisherQueueItem);

		if (!bt_mesh_is_provisioned()) {
			err = -1;
		} else {
			switch (processedMessage.messageType) {
			case UNIT_CONTROL_TYPE:

				if (processedMessage.messageID == SET) {
					err = sendUnitControlFullCmdSet(
						&unitControl, processedMessage.payloadBuffer,
						processedMessage.payloadLength,
						processedMessage.address);
				} else if (processedMessage.messageID == GET) {
					err = sendUnitControlFullCmdGet(
						&unitControl, processedMessage.address,
						processedMessage.payloadBuffer[0]);
				}
				break;
			case ACTIVATION_TYPE:

				if (processedMessage.messageID == SET) {
					err = sendActivationSetPwd(&activation,
								   processedMessage.address,
								   processedMessage.payloadBuffer,
								   processedMessage.payloadLength);
				} else if (processedMessage.messageID == GET) {
					err = sendActivationGetStatus(
						&activation, processedMessage.address,
						processedMessage.payloadBuffer[0]);
				}

				break;
			case SENSOR_TYPE:

				if (processedMessage.messageID == GET) {
				}

				break;
			case MOTOR_TYPE:

				if (processedMessage.messageID == SET) {
					err = sendSetIdMotorLevel(
						&motor, processedMessage.address,
						processedMessage.payloadBuffer[0], //id
						processedMessage.payloadBuffer[1], //level
						processedMessage.payloadBuffer[2]); //seqNum

				} else if (processedMessage.messageID == GET_ID) {
					err = sendGetIdMotorLevel(
						&motor, processedMessage.address,
						processedMessage.payloadBuffer[0],
						processedMessage.payloadBuffer[1]);
				} else if (processedMessage.messageID == GET) {
					err = sendGetAllMotorLevel(
						&motor, processedMessage.address,
						processedMessage.payloadBuffer[0]);
				}

				break;

			default:
				break;
			}
		}
		if (processedMessage.isUartAck) {
			// TODO processing uartAck here
		
		}
	}
}

static void button_handler_cb(uint32_t pressed, uint32_t changed)
{
	if (!bt_mesh_is_provisioned()) {
		return;
	}

	if (pressed & BIT(0)) {
		LOG_INF("button1 Test");
	}
	if (pressed & BIT(1)) {
		LOG_INF("button2 Test ");
	}
	if (pressed & BIT(2)) {
		LOG_INF("button3 Test");
	}
	if (pressed & BIT(3)) {
		LOG_INF("button4 Test");
	}
}

static struct button_handler button_handler = {
	.cb = button_handler_cb,
};

/* Set up a repeating delayed work to blink the DK's LEDs when attention is
 * requested.
 */
static struct k_work_delayable attention_blink_work;
static bool attention;

static void attention_blink(struct k_work *work)
{
	static int idx;
	const uint8_t pattern[] = {
		BIT(0) | BIT(1),
		BIT(1) | BIT(2),
		BIT(2) | BIT(3),
		BIT(3) | BIT(0),
	};

	if (attention) {
		dk_set_leds(pattern[idx++ % ARRAY_SIZE(pattern)]);
		k_work_reschedule(&attention_blink_work, K_MSEC(30));
	} else {
		dk_set_leds(DK_NO_LEDS_MSK);
	}
}

static void attention_on(struct bt_mesh_model *mod)
{
	attention = true;
	k_work_reschedule(&attention_blink_work, K_NO_WAIT);
}

static void attention_off(struct bt_mesh_model *mod)
{
	/* Will stop rescheduling blink timer */
	attention = false;
}

static const struct bt_mesh_health_srv_cb health_srv_cb = {
	.attn_on = attention_on,
	.attn_off = attention_off,
};

static struct bt_mesh_health_srv health_srv = {
	.cb = &health_srv_cb,
};

BT_MESH_HEALTH_PUB_DEFINE(health_pub, 0);

static struct bt_mesh_elem elements[] = {
	BT_MESH_ELEM(1,
		     BT_MESH_MODEL_LIST(BT_MESH_MODEL_CFG_SRV,
					BT_MESH_MODEL_HEALTH_SRV(&health_srv, &health_pub)),
		     BT_MESH_MODEL_LIST(BT_MESH_MODEL_UNIT_CONTROL(&unitControl),
					BT_MESH_MODEL_ACTIVATION(&activation),
					BT_MESH_MODEL_SENSOR(&sensor),
					BT_MESH_MODEL_MOTOR(&motor))),
};

static const struct bt_mesh_comp comp = {
	.cid = CONFIG_BT_COMPANY_ID,
	.elem = elements,
	.elem_count = ARRAY_SIZE(elements),
};

const struct bt_mesh_comp *model_handler_init(void)
{
	k_work_init_delayable(&attention_blink_work, attention_blink);
	dk_button_handler_add(&button_handler);

	return &comp;
}

K_THREAD_DEFINE(publisherThread_id, THREAD_PUBLISHER_STACKSIZE, publisherThread, NULL, NULL, NULL,
		THREAD_PUBLISHER_PRIORITY, 0, 0);
```

## src/model_level_cli_aa.c
```c
#include "model_level_cli_aa.h"
#include <zephyr/logging/log.h>

LOG_MODULE_REGISTER(level_cli_AA, LOG_LEVEL_INF);

int sendGetLvl(struct bt_mesh_lvl_cli level_cli)
{
	LOG_INF("Send [level][GET] op[0x%06x] from addr:0x%04x.  tid:-- ", BT_MESH_LVL_OP_GET,
		bt_mesh_model_elem(level_cli.model)->addr);
	return bt_mesh_lvl_cli_get(&level_cli, NULL, NULL);
}

int sendSetLvl(struct bt_mesh_lvl_cli level_cli)
{
	// for testing
	struct bt_mesh_lvl_set set = {
		.lvl = 10, .transition = &(struct bt_mesh_model_transition){ .delay = 0, .time = 0 }
	};
	set.new_transaction = true;

	LOG_INF("Send [level][SET] op[0x%06x] from addr:0x%04x.  tid:-- ", BT_MESH_LVL_OP_SET,
		bt_mesh_model_elem(level_cli.model)->addr);
	return bt_mesh_lvl_cli_set(&level_cli, NULL, &set, NULL);
}

void levelMotorStatusHandler(struct bt_mesh_lvl_cli *cli, struct bt_mesh_msg_ctx *ctx,
			     const struct bt_mesh_lvl_status *status)
{
	LOG_INF("Received [level][Status] from addr:0x%04x. revc_addr:0x%04x. rssi:%d tid:%d",
		ctx->addr, ctx->recv_dst, ctx->recv_rssi, cli->tid);
	LOG_DBG("current:%d, target:%d", status->current, status->target);
}
```

## src/model_sensor_cli_aa.c
```c
#include "model_sensor_cli_aa.h"
#include <zephyr/logging/log.h>

LOG_MODULE_REGISTER(sensor_cli_AA, LOG_LEVEL_INF);

static void sensorCliDataCb(struct bt_mesh_sensor_cli *cli, struct bt_mesh_msg_ctx *ctx,
			    const struct bt_mesh_sensor_type *sensor,
			    const struct sensor_value *value)
{
	if (sensor->id == bt_mesh_sensor_present_dev_op_temp.id) {
		LOG_INF("Received [Sensor][Temp] op[0x%06x] from addr:0x%04x. revc_addr:0x%04x. rssi:%d tid:",
			cli->model->op->opcode, ctx->addr, ctx->recv_dst, ctx->recv_rssi);
	}
}

const struct bt_mesh_sensor_cli_handlers sensorCliHandlers = {
	.data = sensorCliDataCb,
};
```
