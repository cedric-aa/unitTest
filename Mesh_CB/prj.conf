## CMakeLists.txt
```
#
# Copyright (c) 2021 Nordic Semiconductor ASA
#
# SPDX-License-Identifier: LicenseRef-Nordic-5-Clause
#

cmake_minimum_required(VERSION 3.20.0)

find_package(Zephyr REQUIRED HINTS $ENV{ZEPHYR_BASE})
project(NONE)

set(LIB_ROOT ${CMAKE_CURRENT_SOURCE_DIR}/../lib)

# NORDIC SDK APP START
target_sources(app PRIVATE
	src/main.c
	src/lb_service_handler.c
	src/model_handler.c
	src/model_level_aa.c
	${LIB_ROOT}/mesh_model/src/storage_aa.c
	${LIB_ROOT}/mesh_model/src/vnd_unit_control_aa.c
	${LIB_ROOT}/mesh_model/src/vnd_unit_control_server_aa.c
	${LIB_ROOT}/mesh_model/src/vnd_activation_aa.c
	${LIB_ROOT}/mesh_model/src/vnd_motor_aa.c
	${LIB_ROOT}/mesh_model/src/vnd_motor_server_aa.c
	${LIB_ROOT}/common/src/uart_aa.c
	${LIB_ROOT}/common/src/check_crc_aa.c
	${LIB_ROOT}/common/src/message_format_aa.c)


target_include_directories(app PRIVATE include
	${LIB_ROOT}/mesh_model/include
	${LIB_ROOT}/common/include)

# NORDIC SDK APP END
```

## prj.conf
```kconfig
#
# Copyright (c) 2021 Nordic Semiconductor ASA
#
# SPDX-License-Identifier: LicenseRef-Nordic-5-Clause
#
CONFIG_NCS_SAMPLES_DEFAULTS=y


# General configuration
CONFIG_SYSTEM_WORKQUEUE_STACK_SIZE=4096
CONFIG_FLASH=y
CONFIG_FLASH_MAP=y
CONFIG_NVS=y
CONFIG_SETTINGS=y
CONFIG_HWINFO=y
CONFIG_DK_LIBRARY=y
CONFIG_PM_SINGLE_IMAGE=y
CONFIG_PM_PARTITION_SIZE_SETTINGS_STORAGE=0x8000

# Bluetooth configuration
CONFIG_BT=y
CONFIG_BT_COMPANY_ID=0x0059
CONFIG_BT_DEVICE_NAME="Mesh_CB"
CONFIG_BT_L2CAP_TX_MTU=69
CONFIG_BT_L2CAP_TX_BUF_COUNT=8
CONFIG_BT_OBSERVER=y
CONFIG_BT_PERIPHERAL=y
CONFIG_BT_SETTINGS=y
CONFIG_BT_RX_STACK_SIZE=2200

CONFIG_BT_EXT_ADV=y
CONFIG_BT_EXT_ADV_MAX_ADV_SET=2
CONFIG_BT_MAX_CONN=3

# Disable unused Bluetooth features
CONFIG_BT_CTLR_DUP_FILTER_LEN=0
CONFIG_BT_CTLR_LE_ENC=n
CONFIG_BT_DATA_LEN_UPDATE=n
CONFIG_BT_PHY_UPDATE=n
CONFIG_BT_CTLR_CHAN_SEL_2=n
CONFIG_BT_CTLR_MIN_USED_CHAN=n
CONFIG_BT_CTLR_PRIVACY=n

# Bluetooth mesh configuration
CONFIG_BT_MESH=y
CONFIG_BT_MESH_RELAY=y
CONFIG_BT_MESH_FRIEND=y
CONFIG_BT_MESH_ADV_BUF_COUNT=13
CONFIG_BT_MESH_RX_SEG_MAX=10
CONFIG_BT_MESH_TX_SEG_MAX=10
CONFIG_BT_MESH_PB_GATT=y
CONFIG_BT_MESH_GATT_PROXY=y
CONFIG_BT_MESH_PROXY_USE_DEVICE_NAME=y
CONFIG_BT_MESH_DK_PROV=y
# enable custom model
CONFIG_BT_MESH_MODEL_VND_MSG_CID_FORCE=n
#enable segmentation message
CONFIG_BT_MESH_TX_SEG_MSG_COUNT=2

# Bluetooth mesh models
CONFIG_BT_MESH_LVL_SRV=y


# Enable the LBS service
CONFIG_BT_LBS=y
CONFIG_BT_LBS_POLL_BUTTON=y

# Enable Bluetooth mesh models debug logs
CONFIG_BT_DEBUG_LOG=y
CONFIG_BT_MESH_DEBUG=n
CONFIG_BT_MESH_DEBUG_MODEL=n
CONFIG_BT_MESH_DEBUG_ACCESS=n
CONFIG_LOG=y
CONFIG_BT_MESH_DEBUG_TRANS=n

# Deffered logging helps improve LPN power consumption
# when friendship is established.
CONFIG_LOG_MODE_DEFERRED=y

#disable uart log enable rtt log to use uart async api  
CONFIG_LOG_PROCESS_THREAD=y
CONFIG_LOG_BACKEND_UART=n
CONFIG_LOG_BACKEND_RTT=y
CONFIG_UART_CONSOLE=n
CONFIG_RTT_CONSOLE=y
CONFIG_USE_SEGGER_RTT=y

#uart async api
CONFIG_SERIAL=y
CONFIG_UART_ASYNC_API=y
```

## src/main.c
```c
/*
 * Copyright (c) 2021 Nordic Semiconductor ASA
 *
 * SPDX-License-Identifier: LicenseRef-Nordic-5-Clause
 */

/** @file
 *  @brief Nordic mesh and peripheral coexistence sample
 */

#include <zephyr/bluetooth/bluetooth.h>
#include <bluetooth/mesh/models.h>
#include <bluetooth/mesh/dk_prov.h>
#include <dk_buttons_and_leds.h>
#include "model_handler.h"
#include "lb_service_handler.h"
#include "storage_aa.h"
#include "uart_aa.h"

static void bt_ready(int err)
{
	if (err) {
		printk("Bluetooth init failed (err %d)\n", err);
		return;
	}

	printk("Bluetooth initialized\n");

	dk_leds_init();
	dk_buttons_init(NULL);
	err = uartInit();
	if (err) {
		printk("Initializing uart failed (err %d)\n", err);
		return;
	}

	/*persistant strorage init*/
	permanentStorageSettingsInit();

	err = bt_mesh_init(bt_mesh_dk_prov_init(), model_handler_init());
	if (err) {
		printk("Initializing mesh failed (err %d)\n", err);
		return;
	}

	if (IS_ENABLED(CONFIG_SETTINGS)) {
		settings_load();
	}

	/* This will be a no-op if settings_load() loaded provisioning info */
	bt_mesh_prov_enable(BT_MESH_PROV_ADV | BT_MESH_PROV_GATT);

	printk("Mesh initialized\n");

	lbs_handler_init();
}

void main(void)
{
	int err;

	printk("Initializing...\n");

	err = bt_enable(bt_ready);
	if (err) {
		printk("Bluetooth init failed (err %d)\n", err);
	}
}
```

## include/lb_service_handler.h
```c
/*
 * Copyright (c) 2021 Nordic Semiconductor ASA
 *
 * SPDX-License-Identifier: LicenseRef-Nordic-5-Clause
 */

/**
 * @file
 * @brief LED Button service handler
 */

#ifndef LB_SERVICE_HANDLER_H__
#define LB_SERVICE_HANDLER_H__

#ifdef __cplusplus
extern "C"
{
#endif

    void lbs_handler_init(void);

#ifdef __cplusplus
}
#endif

#endif /* LB_SERVICE_HANDLER_H__ */
```

## include/model_handler.h
```c
/*
 * Copyright (c) 2021 Nordic Semiconductor ASA
 *
 * SPDX-License-Identifier: LicenseRef-Nordic-5-Clause
 */

/**
 * @file
 * @brief Model handler
 */

#ifndef MODEL_HANDLER_H__
#define MODEL_HANDLER_H__

#include <zephyr/bluetooth/mesh.h>
#include "vnd_activation_aa.h"

#ifdef __cplusplus
extern "C" {
#endif

void ble_conn_init(void);

const struct bt_mesh_comp *model_handler_init(void);

struct settingsControlState {
	struct btMeshActivation *activation;
};

extern struct settingsControlState *const ctl;

#ifdef __cplusplus
}
#endif

#endif /* MODEL_HANDLER_H__ */
```

## include/model_level_AA.h
```c
/*
 * Copyright (c) 2021 Nordic Semiconductor ASA
 *
 * SPDX-License-Identifier: LicenseRef-Nordic-5-Clause
 */

/**
 * @file
 * @brief Model of the levelMotor
 */

#ifndef MODEL_LEVEL_AA_H__
#define MODEL_LEVEL_AA_H__

#include <bluetooth/mesh/gen_lvl_srv.h>

struct btMeshlevelMotor
{
	struct bt_mesh_lvl_srv srvLvl;
	struct k_work_delayable levelMotorDelayWork;
	uint32_t timePeriod;
	uint32_t remainingTime;
	uint16_t currentLvl;
	uint16_t targetLvl;
};

void levelMotorWork(struct k_work *work);
extern struct btMeshlevelMotor levelMotors[];
extern const struct bt_mesh_lvl_srv_handlers levelMotorHandlers;

#endif /* MODEL_LEVEL_AA_H__ */
```

## src/lb_service_handler.c
```c
/*
 * Copyright (c) 2021 Nordic Semiconductor ASA
 *
 * SPDX-License-Identifier: LicenseRef-Nordic-5-Clause
 */

#include <zephyr/types.h>
#include <stddef.h>
#include <zephyr/sys/printk.h>
#include <zephyr/sys/byteorder.h>
#include <zephyr/kernel.h>
#include <zephyr/drivers/gpio.h>
#include <soc.h>

#include <zephyr/bluetooth/bluetooth.h>
#include <zephyr/bluetooth/hci.h>
#include <zephyr/bluetooth/conn.h>
#include <zephyr/bluetooth/uuid.h>

#include <bluetooth/services/lbs.h>
#include <dk_buttons_and_leds.h>

#if !DT_NODE_EXISTS(DT_ALIAS(sw0))
#error "Unsupported board: sw0 devicetree alias is not defined"
#endif

#if !DT_NODE_EXISTS(DT_ALIAS(led1))
#error "Unsupported board: led1 devicetree alias is not defined"
#endif

#define LBS_LED DK_LED2
#define LBS_BUTTON DK_BTN1_MSK

static const struct bt_data ad[] = {
	BT_DATA_BYTES(BT_DATA_FLAGS, (BT_LE_AD_GENERAL | BT_LE_AD_NO_BREDR)),
	BT_DATA(BT_DATA_NAME_COMPLETE, CONFIG_BT_DEVICE_NAME, (sizeof(CONFIG_BT_DEVICE_NAME) - 1)),
};

static const struct bt_data sd[] = {
	BT_DATA_BYTES(BT_DATA_UUID128_ALL, BT_UUID_LBS_VAL),
};

static bool ble_button_state;

static void connected(struct bt_conn *conn, uint8_t err)
{
	if (err)
	{
		printk("Connection failed (err %u)\n", err);
		return;
	}

	printk("Connected\n");
}

static void disconnected(struct bt_conn *conn, uint8_t reason)
{
	printk("Disconnected (reason %u)\n", reason);
}

BT_CONN_CB_DEFINE(conn_callbacks) = {
	.connected = connected,
	.disconnected = disconnected,
};

static void app_led_cb(bool led_state)
{
	dk_set_led(LBS_LED, led_state);
}

static bool app_button_cb(void)
{
	return ble_button_state;
}

static struct bt_lbs_cb lbs_callbacs = {
	.led_cb = app_led_cb,
	.button_cb = app_button_cb,
};

static void button_changed(uint32_t button_state, uint32_t has_changed)
{
	if (has_changed & LBS_BUTTON)
	{
		uint32_t user_button_state = button_state & LBS_BUTTON;

		bt_lbs_send_button_state(user_button_state);
		ble_button_state = user_button_state ? true : false;
	}
}

static void lbs_adv_start(void)
{
	int err = bt_le_adv_start(BT_LE_ADV_CONN, ad, ARRAY_SIZE(ad), sd, ARRAY_SIZE(sd));

	if (err)
	{
		printk("Advertising failed to start (err %d)\n", err);
		return;
	}

	printk("Advertising successfully started\n");
}

static void lbs_init(void)
{
	static struct button_handler button_handler = {
		.cb = button_changed,
	};

	dk_button_handler_add(&button_handler);

	int err = bt_lbs_init(&lbs_callbacs);

	if (err)
	{
		printk("Failed to init LBS (err:%d)\n", err);
		return;
	}
}

void lbs_handler_init(void)
{
	/** Initiate and add LBS to the device service list. */
	lbs_init();

	/** Start separate advertiser instance. This will allow two simountanious GATT
	 *  connections to the device, one for Mesh and one for the LBS.
	 */
	lbs_adv_start();
}
```

## src/model_handler.c
```c
#include <zephyr/bluetooth/bluetooth.h>
#include <bluetooth/mesh/models.h>
#include <dk_buttons_and_leds.h>
#include "vnd_motor_server_aa.h"
#include "model_handler.h"
#include "model_level_aa.h"
#include "vnd_unit_control_server_aa.h"
#include <zephyr/logging/log.h>
#include "uart_aa.h"
#include "message_format_aa.h"

LOG_MODULE_REGISTER(model_handler, LOG_LEVEL_INF);

#define THREAD_PUBLISHER_STACKSIZE 2048
#define THREAD_PUBLISHER_PRIORITY 14

struct btMeshUnitControl unitControl = {
	.handlers = &unitControlHandlers,
};

static struct btMeshActivation activation = {
	.handlers = &activationHandlers,
};

struct btMeshMotor motor = {
	.handlers = &motorHandlers,
};

//settings used to store value in the flash
struct settingsControlState settingsCtlState = { .activation = &activation };

struct settingsControlState *const ctl = &settingsCtlState;

void publisherThread(void)
{
	dataQueueItemType publisherQueueItem;
	//int err;

	while (1) {
		k_msgq_get(&publisherQueue, &publisherQueueItem, K_FOREVER);

		LOG_HEXDUMP_DBG(publisherQueueItem.bufferItem, publisherQueueItem.length,
				"Cb Publisher Thread");

		processedMessage processedMessage = processPublisherQueueItem(&publisherQueueItem);

		switch (processedMessage.messageType) {
		case UNIT_CONTROL_TYPE:

			if (processedMessage.messageID == STATUS_CODE) {
				LOG_INF("received uart [UNIT_CONTROL_TYPE][STATUS_CODE] message from the Cb");
				sendUnitControlStatusCode(&unitControl, processedMessage.address,
							  processedMessage.payloadBuffer[0],
							  processedMessage.payloadBuffer[1]);

			} else if (processedMessage.messageID == STATUS) {
				LOG_INF("received uart[UNIT_CONTROL_TYPE][STATUS] message from the Cb");

				unitControlUpdateStatus(&unitControl,
							processedMessage.payloadBuffer,
							processedMessage.payloadLength);
			}

			break;
		case ACTIVATION_TYPE:

			if (processedMessage.messageID == STATUS_CODE) {
				LOG_INF("received uart [ACTIVATION_TYPE][STATUS_CODE] message from the Cb");
				sendActivationStatusCode(&activation, processedMessage.address,
							 processedMessage.payloadBuffer[0],
							 processedMessage.payloadBuffer[1]);

			} else if (processedMessage.messageID == STATUS) {
				LOG_INF("received uart[ACTIVATION_TYPE][STATUS] message from the Cb");

				activationUpdateStatus(&activation, processedMessage.payloadBuffer,
						       processedMessage.payloadLength);
			}

			break;
		case MOTOR_TYPE:

			if (processedMessage.messageID == STATUS_CODE) {
				LOG_INF("received uart [MOTOR_TYPE][STATUS_CODE] message from the Cb");
				sendMotorStatusCode(&motor, processedMessage.address,
						    processedMessage.payloadBuffer[0],
						    processedMessage.payloadBuffer[1]);

			} else if (processedMessage.messageID == STATUS) {
				LOG_INF("received uart [MOTOR_TYPE][STATUS] message from the Cb");
				motorUpdateStatus(&motor, processedMessage.payloadBuffer,
						  processedMessage.payloadLength);
			} else if (processedMessage.messageID == STATUS_ID) {
				LOG_INF("received uart [MOTOR_TYPE][STATUS_ID] message from the Cb");
				motorUpdateStatusId(&motor, processedMessage.payloadBuffer[0],
						    processedMessage.payloadBuffer[1]);
			}

			break;

		default:
			break;
		}
		if (processedMessage.isUartAck) {
			//TODO process UartAck Here
		}
	}
}

/* Set up a repeating delayed work to blink the DK's LEDs when attention is
 * requested.
 */
static struct k_work_delayable attention_blink_work;
static bool attention;

static void attention_blink(struct k_work *work)
{
	static int idx;

	if (attention) {
		dk_set_leds(BIT((idx++) % 2));
		k_work_reschedule(&attention_blink_work, K_MSEC(30));
	} else {
		dk_set_leds(DK_NO_LEDS_MSK);
	}
}

static void attention_on(struct bt_mesh_model *mod)
{
	attention = true;
	k_work_reschedule(&attention_blink_work, K_NO_WAIT);
}

static void attention_off(struct bt_mesh_model *mod)
{
	/* Will stop rescheduling blink timer */
	attention = false;
}

static const struct bt_mesh_health_srv_cb health_srv_cb = {
	.attn_on = attention_on,
	.attn_off = attention_off,
};

static struct bt_mesh_health_srv health_srv = {
	.cb = &health_srv_cb,
};

BT_MESH_HEALTH_PUB_DEFINE(health_pub, 0);

static struct bt_mesh_elem elements[] = {
	BT_MESH_ELEM(1,
		     BT_MESH_MODEL_LIST(BT_MESH_MODEL_CFG_SRV,
					BT_MESH_MODEL_HEALTH_SRV(&health_srv, &health_pub)),
		     BT_MESH_MODEL_LIST(BT_MESH_MODEL_UNIT_CONTROL(&unitControl),
					BT_MESH_MODEL_ACTIVATION(&activation),
					BT_MESH_MODEL_MOTOR(&motor))),
};

static const struct bt_mesh_comp comp = {
	.cid = CONFIG_BT_COMPANY_ID,
	.elem = elements,
	.elem_count = ARRAY_SIZE(elements),
};

const struct bt_mesh_comp *model_handler_init(void)
{
	k_work_init_delayable(&attention_blink_work, attention_blink);

	return &comp;
}

K_THREAD_DEFINE(publisherThread_id, THREAD_PUBLISHER_STACKSIZE, publisherThread, NULL, NULL, NULL,
		THREAD_PUBLISHER_PRIORITY, 0, 0);
```

## src/model_level_AA.c
```c
#include "model_level_aa.h"
#include <zephyr/logging/log.h>

LOG_MODULE_REGISTER(lvl_srv_AA, LOG_LEVEL_INF);

static void startNewLvlTrans(const struct bt_mesh_lvl_set *set, struct btMeshlevelMotor *ctx)
{
	uint32_t time = set->transition ? set->transition->time : 0;
	uint32_t delay = set->transition ? set->transition->delay : 0;

	ctx->targetLvl = set->lvl;
	ctx->remainingTime = time;
	k_work_reschedule(&ctx->levelMotorDelayWork, K_MSEC(delay));
}

static void updateLvlChange(const struct bt_mesh_lvl_set *set, struct btMeshlevelMotor *ctx)
{
	if (!set->transition) {
		ctx->currentLvl = set->lvl;
		ctx->targetLvl = set->lvl;
	} else {
		startNewLvlTrans(set, ctx);
	}
}

static void levelMotorGet(struct bt_mesh_lvl_srv *srv, struct bt_mesh_msg_ctx *ctx,
			  struct bt_mesh_lvl_status *rsp)
{
	struct btMeshlevelMotor *levelMotor = CONTAINER_OF(srv, struct btMeshlevelMotor, srvLvl);
	int Motorid = levelMotor - &levelMotors[0];
	LOG_INF("Received [level][GET] op[0x%06x] LevelMotor[%d] from addr:%d revc_addr:%d rssi:%d tid:%d",
		srv->model->op->opcode, Motorid, ctx->addr, ctx->recv_dst, ctx->recv_rssi,
		srv->tid.tid);

	// Set the remaining time for the response to the remaining time of the work delayable plus the remaining time of the context
	rsp->remaining_time = k_ticks_to_ms_ceil32(k_work_delayable_remaining_get(
				      &levelMotor->levelMotorDelayWork)) +
			      levelMotor->remainingTime;

	// Set the current and target levels for the response
	rsp->current = levelMotor->currentLvl;
	rsp->target = levelMotor->targetLvl;
}
static void levelMotorSet(struct bt_mesh_lvl_srv *srv, struct bt_mesh_msg_ctx *ctx,
			  const struct bt_mesh_lvl_set *set, struct bt_mesh_lvl_status *rsp)
{
	struct btMeshlevelMotor *levelMotor = CONTAINER_OF(srv, struct btMeshlevelMotor, srvLvl);
	int Motorid = levelMotor - &levelMotors[0];
	LOG_INF("Received [level][SET] levelMotors[%d] from addr:%d to:%d rssi:%d tid:%d", Motorid,
		ctx->addr, ctx->recv_dst, ctx->recv_rssi, srv->tid.tid);

	if (set->new_transaction) {
		if (set->lvl != levelMotor->targetLvl) {
			updateLvlChange(set, levelMotor);
		}
	}

	rsp->current = levelMotor->currentLvl;
	rsp->target = levelMotor->targetLvl;
	rsp->remaining_time = k_ticks_to_ms_ceil32(k_work_delayable_remaining_get(
				      &levelMotor->levelMotorDelayWork)) +
			      levelMotor->remainingTime;
}
static void levelMotorDelta(struct bt_mesh_lvl_srv *srv, struct bt_mesh_msg_ctx *ctx,
			    const struct bt_mesh_lvl_delta_set *delta_set,
			    struct bt_mesh_lvl_status *rsp)
{
	LOG_DBG("level delta");
}
static void levelMotorMove(struct bt_mesh_lvl_srv *srv, struct bt_mesh_msg_ctx *ctx,
			   const struct bt_mesh_lvl_move_set *move_set,
			   struct bt_mesh_lvl_status *rsp)
{
	LOG_DBG("level move");
}

const struct bt_mesh_lvl_srv_handlers levelMotorHandlers = { .set = levelMotorSet,
							     .get = levelMotorGet,
							     .move_set = levelMotorMove,
							     .delta_set = levelMotorDelta };

void levelMotorWork(struct k_work *work)
{
	int err;

	struct btMeshlevelMotor *levelMotor =
		CONTAINER_OF(work, struct btMeshlevelMotor, levelMotorDelayWork);

	if (levelMotor->remainingTime) {
		k_work_reschedule(&levelMotor->levelMotorDelayWork,
				  K_MSEC(levelMotor->remainingTime));
		levelMotor->remainingTime = 0;
	} else {
		/* Publish the new value at the end of the transition */
		struct bt_mesh_lvl_status status;

		// Update current level to target level and set status values
		levelMotor->currentLvl = levelMotor->targetLvl;
		status.current = levelMotor->currentLvl;
		status.target = levelMotor->targetLvl;
		status.remaining_time = levelMotor->remainingTime;

		// Publish the new values
		err = bt_mesh_lvl_srv_pub(&levelMotor->srvLvl, NULL, &status);
		LOG_INF("Send [level][STATUS] op[0x%06x] from addr:0x%04x.to 0x%04x.   tid:-- ",
			BT_MESH_LVL_OP_STATUS, bt_mesh_model_elem(levelMotor->srvLvl.model)->addr,
			levelMotor->srvLvl.pub.addr);

		// Log error if failed to publish
		if (err) {
			LOG_ERR("error:[%d]", err);
		}
	}
}
```
